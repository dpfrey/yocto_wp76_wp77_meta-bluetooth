## conf/layer.conf
```bitbake
# TODO: What does setting BBPATH do?
# TODO: What is $LAYERDIR?
BBPATH .= ":${LAYERDIR}"

BBFILES += "${LAYERDIR}/*/*.bb \
            ${LAYERDIR}/*/*.bbappend"

BBFILE_COLLECTIONS += "bluetooth"
BBFILE_PATTERN_bluetooth = "^${LAYERDIR}/" 
BBFILE_PRIORITY_bluetooth = "5"
LAYERVERSION_bluetooth = "1"
```
